## drivers/i2c/chips/Kconfig
```kconfig
#
# Miscellaneous I2C chip drivers configuration
#
# *** DEPRECATED! Do not add new entries! See Makefile ***
#

menu "Miscellaneous I2C Chip support"

config DS1682
	tristate "Dallas DS1682 Total Elapsed Time Recorder with Alarm"
	depends on EXPERIMENTAL
	help
	  If you say yes here you get support for Dallas Semiconductor
	  DS1682 Total Elapsed Time Recorder.

	  This driver can also be built as a module.  If so, the module
	  will be called ds1682.

config SENSORS_TSL2550
	tristate "Taos TSL2550 ambient light sensor"
	depends on EXPERIMENTAL
	help
	  If you say yes here you get support for the Taos TSL2550
	  ambient light sensor.

	  This driver can also be built as a module.  If so, the module
	  will be called tsl2550.

config SENSORS_AKM8976
	tristate "AKM8976 Compass Driver"
	depends on I2C
	help
	 AKM8976 Compass Driver implemented by HTC.

config SENSORS_AKM8973
	tristate "AKM8973 Compass Driver"
	depends on I2C
	help
	 AKM8973 Compass Driver implemented by HTC.

config SENSORS_PCA963X
	tristate "Philips PCA963X 4-bit I2C-bus LED"
	depends on I2C && EXPERIMENTAL
	help
	 If you say yes here you get support for the Philips PCA963X
	 4-bit I2C-bus LED.

	 This driver can also be built as a module.  If so, the module
	 will be called pca963X.

config SENSORS_MT9T013
	tristate "MT9T013 Camera Driver"
	depends on I2C
	default y
	help
	 MT9T013 Camera Driver implemented by HTC.

config VP_A1026
	tristate "A1026 Voice Processor Driver"
	depends on I2C
	help
	  A1026 Voice Processor Driver implemented by HTC.

config AMP_MAX97000
	bool "Maxim MAX97000 Amp Subsystem Driver"
	depends on I2C 
	default n

config FSA9280
	bool "Fairchild FSA9280 USB switch Driver"
	depends on I2C
	default y

config SENSORS_BMA_ACCEL
	tristate "BMA acceleration sensor support"
	depends on I2C=y
	default y
	help
	  If you say yes here you get support for Bosch Sensortec's 
	  acceleration sensors BMA.

config SENSORS_KR3D_ACCEL
	tristate "KR3Dx acceleration sensor support"
	depends on I2C=y
	default n
	help
	  If you say yes here you get support for STMicro's 
	  acceleration sensors KR3Dx.

config SENSORS_MMC31XX
	tristate "MEMSIC Magnetic Sensor Driver Support"
	depends on I2C
	default y
	help
	  If you say yes here you get support for the MEMSIC magnateic sensor
config ECOMPASS
	tristate "MEMSIC eCompass Sensor Driver Support"
	depends on I2C
	default y
	help
	  If you say yes here you get support for the MEMSIC magnateic sensor

config SENSORS_GP2A
	tristate "GP2A sensor support"
	depends on I2C=y
	default n
	help
	  If you say yes here you get support for Sharp's sensor GP2A.

config SENSORS_TAOS
	tristate "TAOS sensor support"
	depends on I2C=y
	default n
	help
	  If you say yes here you get support for TAOS's proximity sensor.
endmenu
```

## drivers/media/video/msm/Kconfig
```kconfig
comment "Camera Sensor Selection"
config MT9T013
	bool "Sensor mt9t013 (BAYER 3M)"
	depends on MSM_CAMERA
	default n
	---help---
	  MICRON 3M Bayer Sensor with AutoFocus

config MT9D112
	bool "Sensor mt9d112 (YUV 2M)"
	depends on MSM_CAMERA
	default n
	---help---
	  MICRON 2M YUV Sensor

config S5K4CA
	bool "Sensor s5k4ca (3M)"
	default n
	---help---
	  SAMSUNG 3M CMOS Sensor

config SR200PC10
	bool "Sensor sr200pc10 (2M)"
	default n
	---help---
	  SILICON-FILE 2M CMOS Sensor

config S5K5CA
	bool "Sensor s5k5ca 1/5 (3M)"
	default n
	---help---
	  SAMSUNG 3M CMOS Sensor

config S5K5CAFF
	bool "Sensor s5k5caff 1/5 (3M)"
	default n
	---help---
	  SAMSUNG 3M CMOS Sensor

config S5K5CCAF
	bool "Sensor s5k5cc 1/5 (3M/AF)"
	default n
	---help---
	  SAMSUNG 3M CMOS Sensor



config S5K5CCFF
	bool "Sensor s5k5cc 1/5 (3M/FF)"
	default n
	---help---
	  SAMSUNG 3M CMOS Sensor


config ISX006
	bool "Sensor isx006 (5M)"
	default n
	---help---
	  SONY 5M CMOS Sensor 

config S5K4ECGX
	bool "Sensor s5k4ecgx (5M)"
	default n
	---help---
	  SAMSUNG LSI 5M CMOS Sensor 	  

config S5K4ECGX_COOPER
	bool "Sensor s5k4ecgx (5M)"
	default n
	---help---
	  SAMSUNG LSI 5M CMOS Sensor 	  

config MT9P012
	bool "Sensor mt9p012 (BAYER 5M)"
	depends on MSM_CAMERA
	default n
	---help---
	  MICRON 5M Bayer Sensor with Autofocus

choice
	prompt "AF module"
	depends on MT9P012
	default MSM_CAMERA_AF_FOXCONN

config MSM_CAMERA_AF_FOXCONN
	bool "FOXCONN Module"
	help
	  This driver supports FOXCONN AF module for 5M Bayer sensor

config MSM_CAMERA_AF_BAM
	bool "BAM Module"
	help
	  This driver supports BAM AF module for 5M Bayer sensor

endchoice

config MT9P012_KM
	bool "Sensor mt9p012 KM module (BAYER 5M)"
	depends on MSM_CAMERA
	default y
	---help---
	  MICRON 5M Bayer Sensor KM modules with Autofocus

config S5K3E2FX
	bool "Sensor s5k3e2fx (Samsung 5M)"
	depends on MSM_CAMERA
	default y
	---help---
	  Samsung 5M with Autofocus

config VB6801
	bool "Sensor vb6801"
	depends on MSM_CAMERA
	---help---
	  5M with flash

config MSM_CAMERA_FLASH
	bool "Qualcomm MSM camera flash support"
	depends on MSM_CAMERA
	default y
	---help---
	  Enable support for LED flash for msm camera

config MSM_GEMINI
	tristate "Qualcomm MSM Gemini Jpeg Engine support"
	depends on MSM_CAMERA
	default M
	---help---
	  Enable support for Gemini Jpeg Engine
```
